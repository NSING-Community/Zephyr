/*
 * Copyright (c) 2026 Nations Technologies
 * SPDX-License-Identifier: Apache-2.0
 */

/ {
	aliases {
		watchdog0 = &wwdg1;
	};
};

/* WWDG1 is the Cortex-M7 window watchdog; keep IWDG out of the test. */
&iwdg1 {
	status = "disabled";
};

&wwdg1 {
	status = "okay";
};
