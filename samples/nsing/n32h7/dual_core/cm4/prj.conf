## CMakeLists.txt
```
# Copyright (c) 2026 Nations Technologies
# SPDX-License-Identifier: Apache-2.0

cmake_minimum_required(VERSION 3.20.0)
find_package(Zephyr REQUIRED HINTS $ENV{ZEPHYR_BASE})
project(n32h7_cm4)

target_sources(app PRIVATE src/main.c)
```

## prj.conf
```kconfig
# Copyright (c) 2026 Nations Technologies
# SPDX-License-Identifier: Apache-2.0

# The Cortex-M4 image waits for the Cortex-M7 ready state by default
# (CONFIG_N32H78X_CM4_WAIT_FOR_CM7); no further options are required here.
```

## src/main.c
```c
/*
 * Copyright (c) 2026 Nations Technologies
 * SPDX-License-Identifier: Apache-2.0
 */

#include <zephyr/kernel.h>

int main(void)
{
	uint32_t seconds = 0U;

	printk("Hello from the Cortex-M4 image\n");

	while (1) {
		k_msleep(1000);
		printk("Cortex-M4 alive for %u s\n", ++seconds);
	}

	return 0;
}
```
