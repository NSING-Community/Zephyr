## CMakeLists.txt
```
# Copyright (c) 2026 Nations Technologies
# SPDX-License-Identifier: Apache-2.0

cmake_minimum_required(VERSION 3.20.0)
find_package(Zephyr REQUIRED HINTS $ENV{ZEPHYR_BASE})
project(n32h7_dual_core)

target_sources(app PRIVATE src/main.c)
```

## Kconfig.sysbuild
```
# Copyright (c) 2026 Nations Technologies
# SPDX-License-Identifier: Apache-2.0

source "share/sysbuild/Kconfig"

config N32H7_CM4_IMAGE
	bool "Build the Cortex-M4 image alongside the Cortex-M7 image"
	depends on BOARD_N32H787XIB7_STB_N32H787_CM7
	default y
	help
	  Build the Cortex-M4 image from the cm4/ application directory. The
	  image is build-only because the two cores use separate xSPI windows
	  and are programmed independently.
```

## prj.conf
```kconfig
# Copyright (c) 2026 Nations Technologies
# SPDX-License-Identifier: Apache-2.0

# Release the independently linked Cortex-M4 image at 0x15080000 once the
# Cortex-M7 kernel reaches POST_KERNEL.
CONFIG_N32H78X_START_M4=y
```

## src/main.c
```c
/*
 * Copyright (c) 2026 Nations Technologies
 * SPDX-License-Identifier: Apache-2.0
 */

#include <zephyr/kernel.h>

int main(void)
{
	printk("Hello from the Cortex-M7 image\n");
	printk("Releasing the Cortex-M4 image\n");

	while (1) {
		k_msleep(1000);
	}

	return 0;
}
```
