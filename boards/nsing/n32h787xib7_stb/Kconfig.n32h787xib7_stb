## boards/nsing/n32h787xib7_stb/Kconfig.n32h787xib7_stb
```kconfig
# Copyright (c) 2026 Nations Technologies
# SPDX-License-Identifier: Apache-2.0

config BOARD_N32H787XIB7_STB
	select SOC_N32H787 if BOARD_N32H787XIB7_STB_N32H787_CM7
	select SOC_N32H787_CM4 if BOARD_N32H787XIB7_STB_N32H787_CM4
```

## boards/nsing/n32h787xib7_stb/board.yml
```yaml
board:
  name: n32h787xib7_stb
  full_name: N32H787XIB7-STB
  vendor: nsing
  socs:
    - name: n32h787
```

## boards/nsing/n32h787xib7_stb/n32h787xib7_stb_n32h787_cm7_defconfig
```kconfig
# SPDX-License-Identifier: Apache-2.0

CONFIG_ARM_MPU=y
CONFIG_FPU=y
CONFIG_FP_HARDABI=y
CONFIG_SYS_CLOCK_HW_CYCLES_PER_SEC=64000000

CONFIG_CLOCK_CONTROL=y
CONFIG_SERIAL=y
CONFIG_CONSOLE=y
CONFIG_UART_CONSOLE=y
```

## drivers/clock_control/Kconfig.n32h7
```kconfig
# Copyright (c) 2026 Nations Technologies
# SPDX-License-Identifier: Apache-2.0

config CLOCK_CONTROL_N32H7
	bool "N32H7 clock control"
	default y
	depends on SOC_SERIES_N32H78X
	help
	  Provide the N32H7 peripheral gate controller and the current system
	  clock rate to peripheral drivers.
```

## drivers/gpio/Kconfig.n32h7
```kconfig
# Copyright (c) 2026 Nations Technologies
# SPDX-License-Identifier: Apache-2.0

config GPIO_N32H7
	bool "N32H7 GPIO driver"
	default y
	depends on SOC_SERIES_N32H78X
	depends on CLOCK_CONTROL
	help
	  Enable the N32H7 GPIO driver. Interrupt/EXTI support is deferred until
	  the interrupt routing has been validated on hardware.
```

## drivers/mbox/Kconfig.n32h7
```kconfig
# Copyright (c) 2026 Nations Technologies
# SPDX-License-Identifier: Apache-2.0

config MBOX_N32H7_DCMU
	bool "N32H7 DCMU mailbox"
	default y
	depends on SOC_SERIES_N32H78X
	depends on DT_HAS_NSING_N32H7_DCMU_ENABLED
	select N32H78X_DCMU_INIT
	help
	  Expose the N32H78x dual-core messaging unit through Zephyr's MBOX API.
```

## drivers/pinctrl/Kconfig.n32h7
```kconfig
# Copyright (c) 2026 Nations Technologies
# SPDX-License-Identifier: Apache-2.0

config PINCTRL_N32H7
	bool "Nations N32H78x pin controller backend"
	default y
	depends on DT_HAS_NSING_N32H7_PINCTRL_ENABLED
	help
	  Enable the N32H78x AFIO/GPIO pinmux backend. This backend is separate
	  from PINCTRL_N32, which is the legacy N32G45x AFIO implementation.
```

## drivers/serial/Kconfig.n32h7
```kconfig
# Copyright (c) 2026 Nations Technologies
# SPDX-License-Identifier: Apache-2.0

config UART_N32H7
	bool "Nations N32H7 USART driver"
	default y
	depends on SERIAL
	depends on CLOCK_CONTROL
	depends on PINCTRL
	depends on DT_HAS_NSING_N32H7_UART_ENABLED
	select USE_NSING_USART
	select SERIAL_HAS_DRIVER
	help
	  Enable the N32H78x USART driver. The driver consumes the
	  clock phandle from each UART node, so USART instances are selected by
	  devicetree rather than by a SoC-specific base-address test.

config UART_N32H7_INTERRUPT
	bool "N32H7 interrupt-driven USART API"
	depends on UART_N32H7
	select SERIAL_SUPPORT_INTERRUPT
	select UART_INTERRUPT_DRIVEN
	default y
	help
	  Enable the optional interrupt-driven FIFO and callback API.
```

## drivers/watchdog/Kconfig.nsing
```kconfig
# Copyright (c) 2026 Nations Technologies
# SPDX-License-Identifier: Apache-2.0

config WDT_N32_IWDG
	bool "Nations N32 independent watchdog driver"
	default y
	depends on DT_HAS_NSING_N32_IWDG_ENABLED
	depends on CLOCK_CONTROL
	help
	  Enable the independent watchdog (IWDG) driver for Nations N32 MCUs.

config WDT_N32_WWDG
	bool "Nations N32 window watchdog driver"
	default y
	depends on DT_HAS_NSING_N32_WWDG_ENABLED
	depends on CLOCK_CONTROL
	help
	  Enable the window watchdog (WWDG) driver for Nations N32 MCUs.

config WDT_N32H7_IWDG
	bool "Nations N32H7 independent watchdog driver"
	default y
	depends on SOC_SERIES_N32H78X
	depends on DT_HAS_NSING_N32H7_IWDG_ENABLED
	depends on CLOCK_CONTROL
	help
	  Enable the multi-instance N32H78x IWDG driver.

config WDT_N32H7_WWDG
	bool "Nations N32H7 window watchdog driver"
	default y
	depends on SOC_SERIES_N32H78X
	depends on DT_HAS_NSING_N32H7_WWDG_ENABLED
	depends on CLOCK_CONTROL
	help
	  Enable the multi-instance N32H78x WWDG driver.
```

## dts/bindings/adc/nsing,n32h7-adc.yaml
```yaml
# Copyright (c) 2026 Nations Technologies
# SPDX-License-Identifier: Apache-2.0

description: Nations Technologies N32H7 ADC

compatible: "nsing,n32h7-adc"

include: [adc-controller.yaml, pinctrl-device.yaml]

properties:
  reg:
    required: true

  clocks:
    required: true

  interrupts:
    required: true

  "#io-channel-cells":
    const: 1

  channels:
    type: int
    description: Number of external channels
    required: true

io-channel-cells:
  - input
```

## dts/bindings/clock/nsing,n32h7-rcc.yaml
```yaml
# Copyright (c) 2026 Nations Technologies
# SPDX-License-Identifier: Apache-2.0

description: Nations Technologies N32H78x RCC clock controller

compatible: "nsing,n32h7-rcc"

include: [base.yaml, clock-controller.yaml]

properties:
  reg:
    required: true

  "#clock-cells":
    const: 1

  clock-frequency:
    type: int
    required: true
    description: SYSCLK in Hz at reset/SoC initialization.

clock-cells:
  - clkid
```

## dts/bindings/dma/nsing,n32h7-dma.yaml
```yaml
# Copyright (c) 2026 Nations Technologies
# SPDX-License-Identifier: Apache-2.0

description: Nations Technologies N32H7 DMA controller

compatible: "nsing,n32h7-dma"

include: [dma-controller.yaml]

properties:
  reg:
    required: true

  clocks:
    required: true

  interrupts:
    required: true

  dma-channels:
    required: true

  nsing,mem2mem:
    type: boolean
    description: The DMA controller supports memory to memory transfer

  "#dma-cells":
    const: 3

dma-cells:
  - channel
  - request
  - config
```

## dts/bindings/gpio/nsing,n32h7-gpio.yaml
```yaml
# Copyright (c) 2026 Nations Technologies
# SPDX-License-Identifier: Apache-2.0

description: Nations N32H7 GPIO controller
compatible: "nsing,n32h7-gpio"
include: [gpio-controller.yaml, base.yaml]
properties:
  reg:
    required: true
  clocks:
    required: true
gpio-cells:
  - pin
  - flags
```

## dts/bindings/mbox/nsing,n32h7-dcmu.yaml
```yaml
# Copyright (c) 2026 Nations Technologies
# SPDX-License-Identifier: Apache-2.0

description: Nations N32H7 dual-core messaging unit

compatible: "nsing,n32h7-dcmu"

include: [base.yaml, mailbox-controller.yaml]

properties:
  interrupts:
    required: true

mbox-cells:
  - channel
```

## dts/bindings/pinctrl/nsing,n32h7-pinctrl.yaml
```yaml
# Copyright (c) 2026 Nations Technologies
# SPDX-License-Identifier: Apache-2.0

description: |
  N32H7 pin control group

  A state holds one pinmux cell per pin. Build the cell with N32H7_PINMUX()
  from <zephyr/dt-bindings/pinctrl/n32h7-pinctrl.h>; for example

      pinmux = <N32H7_PINMUX('A', 9, 7, N32H7_PIN_AF, N32H7_PULL_UP)>;

  configures PA9 as alternate function 7 with a pull-up.  Use
  N32H7_PINMUX_OD() instead for an open-drain output, as required by I2C:

      pinmux = <N32H7_PINMUX_OD('B', 7, 4, N32H7_PIN_AF, N32H7_PULL_UP)>;

compatible: "nsing,n32h7-pinctrl"

include: base.yaml

properties:
  pinmux:
    type: array
    required: true
```

## dts/bindings/serial/nsing,n32h7-uart.yaml
```yaml
# Copyright (c) 2026 Nations Technologies
# SPDX-License-Identifier: Apache-2.0

description: Nations N32H7 USART controller
compatible: "nsing,n32h7-uart"
include: [uart-controller.yaml, base.yaml]
properties:
  pinctrl-0:
    type: phandles
  pinctrl-names:
    type: string-array
  reg:
    required: true
  interrupts:
    required: true
  clocks:
    required: true
```

## dts/bindings/spi/nsing,n32h7-spi.yaml
```yaml
# Copyright (c) 2026 Nations Technologies
# SPDX-License-Identifier: Apache-2.0

description: Nations Technologies N32H7 SPI controller

compatible: "nsing,n32h7-spi"

include: [spi-controller.yaml, pinctrl-device.yaml]

properties:
  reg:
    required: true

  clocks:
    required: true

  interrupts:
    required: true
```

## dts/bindings/watchdog/nsing,n32h7-iwdg.yaml
```yaml
# Copyright (c) 2026 Nations Technologies
# SPDX-License-Identifier: Apache-2.0

description: Nations Technologies N32H78x independent watchdog

compatible: "nsing,n32h7-iwdg"

include: [base.yaml]

properties:
  reg:
    required: true
  clocks:
    required: true
```

## dts/bindings/watchdog/nsing,n32h7-wwdg.yaml
```yaml
# Copyright (c) 2026 Nations Technologies
# SPDX-License-Identifier: Apache-2.0

description: Nations Technologies N32H78x window watchdog

compatible: "nsing,n32h7-wwdg"

include: [base.yaml]

properties:
  reg:
    required: true
  clocks:
    required: true
  interrupts:
    required: true
```

## soc/nsing/nsing_n32/n32h78x/Kconfig
```kconfig
# Copyright (c) 2026 Nations Technologies
# SPDX-License-Identifier: Apache-2.0

config SOC_SERIES_N32H78X
	bool
	select HAS_NSING_HAL
	select BUILD_OUTPUT_HEX
	select PINCTRL
	select ARM
	select CPU_CORTEX_M7 if SOC_N32H787 && !SOC_N32H787_CM4
	select CPU_CORTEX_M4 if SOC_N32H787_CM4
	select CPU_CORTEX_M_HAS_DWT
	select CPU_HAS_ARM_MPU
	# Both cores have an FPU; the Cortex-M7 one is double precision and the
	# Cortex-M4 one is single precision.
	select CPU_HAS_FPU
	select CPU_HAS_FPU_DOUBLE_PRECISION if SOC_N32H787 && !SOC_N32H787_CM4
	select CPU_HAS_ICACHE if SOC_N32H787 && !SOC_N32H787_CM4
	select CPU_HAS_DCACHE if SOC_N32H787 && !SOC_N32H787_CM4
	select SOC_EARLY_INIT_HOOK
	select SOC_RESET_HOOK
	help
	  Nations N32H78x dual-core SoC support. CM7 and CM4 are built as separate
	  images; this is not a symmetric-MP target.

config N32H78X_START_M4
	bool "Start Cortex-M4 from the Cortex-M7 image"
	depends on SOC_SERIES_N32H78X
	default n
	help
	  Experimental. Release CM4 from reset during POST_KERNEL using the
	  independent image linked at 0x15080000. Keep disabled until that image,
	  its vector table and shared-memory/cache protocol have been validated.

config N32H78X_CM4_WAIT_FOR_CM7
	bool "Hold CM4 until CM7 publishes ready"
	depends on SOC_N32H787_CM4
	default y
	help
	  Make the CM4 early-init hook wait for the CM7 image to finish system
	  and shared-memory initialization. Disable only for standalone CM4
	  bring-up where CM7 is not present.

config N32H78X_CM4_BOOT_TIMEOUT_LOOPS
	int "CM4 wait loops for CM7 ready"
	depends on SOC_N32H787_CM4 && N32H78X_CM4_WAIT_FOR_CM7
	default 100000000
	range 1 4294967295
	help
	  Maximum number of early-init polling iterations while CM4 waits for
	  CM7 to publish its ready state. On timeout CM4 records an error state
	  in shared SRAM and remains parked instead of touching shared peripherals.

config N32H78X_DCMU_INIT
	bool "Initialize DCMU mailbox during SoC early init"
	depends on SOC_SERIES_N32H78X
	default n
	help
	  Enable the dual-core mailbox clock and reset pulse during early SoC
	  initialization. Keep disabled until DCMU access and MPU setup are
	  validated on the target.

config N32H78X_DISABLE_WFI
	bool "Disable WFI in the N32H78x idle loop"
	depends on SOC_SERIES_N32H78X
	select ARM_ON_ENTER_CPU_IDLE_HOOK
	default y
	help
	  N32H7 gates the CM7 clock in Sleep in a way that currently prevents
	  reliable SWD/DAP access after WFI. Keep this enabled for stable bring-up
	  and debugging. Disable it only when the N32H7 low-power/debug path has
	  been validated on the target hardware.

config N32H78X_DEBUG_LOW_POWER
	bool "Keep N32H7 debug clocks running in low-power test"
	depends on SOC_SERIES_N32H78X
	default n
	help
	  Set the N32H7 DBG sleep/stop/standby bits for both CPUs so SWD can
	  continue to inspect a low-power test image. This increases current and
	  must remain disabled in production power measurements.
```

## soc/nsing/nsing_n32/n32h78x/Kconfig.soc
```kconfig
# Copyright (c) 2026 Nations Technologies
# SPDX-License-Identifier: Apache-2.0

config SOC_SERIES_N32H78X
	bool
	select SOC_FAMILY_NSING_N32H7

config SOC_SERIES
	default "n32h78x" if SOC_SERIES_N32H78X

config SOC_N32H787
	bool
	select SOC_SERIES_N32H78X

config SOC_N32H787_CM4
	bool
	select SOC_SERIES_N32H78X

config SOC
	default "n32h787" if SOC_N32H787 || SOC_N32H787_CM4

config SOC_FAMILY_NSING_N32H7
	bool
```
